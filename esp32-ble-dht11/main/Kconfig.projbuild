## esp32-ble-dht11/main/Kconfig.projbuild
```kconfig
menu "Sensor Configuration"

    orsource "$IDF_PATH/examples/common_components/env_caps/$IDF_TARGET/Kconfig.env_caps"

    config DHT11_SENSOR_GPIO
        int "DHT11 GPIO number"
        range ENV_GPIO_RANGE_MIN ENV_GPIO_OUT_RANGE_MAX
        default 32 if IDF_TARGET_ESP32
        default 8
        help
            GPIO number for DHT11 sensor

    config BLE_SECURITY_PASSKEY
        int "BLE Security PassKey"
        range 1 1000000
        default 666666
        help
            BLE Security PassKey
endmenu
```
